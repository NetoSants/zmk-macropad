#include <behaviors.dtsi>
#include <dt-bindings/zmk/keys.h>

/ {
    keymap {
        compatible = "zmk,keymap";

        default_layer {
            bindings = <&none>;
            sensor-bindings = <&inc_dec_kp UP_ARROW DOWN_ARROW>;
        };
    };
};
