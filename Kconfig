## config/west.yml
```yaml
manifest:
  defaults:
    revision: main
  remotes:
    - name: zmkfirmware
      url-base: https://github.com/zmkfirmware
    - name: nrfconnect
      url-base: https://github.com/nrfconnect
  projects:
    - name: zmk
      remote: zmkfirmware
      import: app/west.yml
    - name: zephyr
      remote: nrfconnect
      repo-path: sdk-zephyr
      revision: 43c5dc730e385c238ce00ea91d1a772709b49abf
      import:
        name-allowlist:
          - hal_nordic
          - cmsis
          - nrfxlib
    - name: nrfxlib
      remote: nrfconnect
      revision: main
      path: modules/lib/nrfxlib
  self:
    path: config
```

## dts/bindings/sensor/custom,ec11-encoder.yaml
```yaml
# SPDX-License-Identifier: MIT

description: Custom EC11 encoder driver for ZMK

compatible: "custom,ec11-encoder"

properties:
  a-gpios:
    type: phandle-array
    required: true
    description: GPIO for encoder channel A

  b-gpios:
    type: phandle-array
    required: true
    description: GPIO for encoder channel B

  steps:
    type: int
    required: false
    default: 80
    description: Number of steps per revolution
```
